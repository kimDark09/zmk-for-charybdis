## config/west.yml
```yaml
manifest:
  remotes:
    - name: zmkfirmware
      url-base: https://github.com/DoctorWangWang
    - name: badjeff
      url-base: https://github.com/badjeff
  projects:
    - name: zmk
      remote: badjeff
      revision: main
      import: app/west.yml
    - name: zmk-input-behavior-listener
      remote: badjeff
      revision: main      
  self:
    path: config
```
